
#define BAUD_RATE 115200        // Velocidad de comunicación serial

#include "Caracterizador.h"
#include "Segmentador.h"
#include "Varios.h"

Cr_Control c_car;

/* ventana de señales sEMG*/
Sg_canalData data[NUM_CHANNELS];
/* vector de cataceristicas*/
Cr_Caracteristicas veChar[NUM_CHANNELS*(NUM_CAR_T+NUM_CAR_F)]; 


//Ejemplo
float exam[] = {-36.680711608767794f, -33.592442513048354f, 36.84223991360335f, 5.3516252300900895f, 32.08713185998279f, -23.093708538445647f, 13.643245848027288f, 91.3948070840651f, 58.40297454774975f, 10.629410106259712f, -66.07582175533216f, -30.71827516626261f, 31.11068174810516f,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 132.99425166130771f, 107.78337668827764f};



void setup() {
  Serial.begin(BAUD_RATE);

  //LLenar ventanasde segmentación 
  for (int i=0;i<NUM_CHANNELS;i++){
    for(int j=0;j<WINDOW_SIZE;j++){
        //data[i].canal[j]=(i+1)*(j);
        data[i].canal[j]=exam[j];
    }
  }


  //Caracterizador 
  Cr_Inicie(&c_car, data,veChar);

}

void loop(){

  // Array de punteros a funciones
/*  
    for (int i=0;i<NUM_CHANNELS;i++){
      for(int j=0;j<WINDOW_SIZE;j++){
          Serial.print(data[i].canal[j]);
          Serial.print(",");
      }
    Serial.println();
  }
*/

//float inicio=millis();
Cr_Procese(&c_car);

  Serial.println("Ventanas:");
  for (int i=0;i<NUM_CHANNELS;i++){
    for(int j=0;j<WINDOW_SIZE;j++){
        Serial.print(data[i].canal[j]);
        Serial.print(",");
    }
    Serial.println();
  }
  
  Serial.println("Caracteristicas:");
  for(int j=0;j<NUM_CHANNELS*(NUM_CAR_T+NUM_CAR_F);j++){
      Serial.print(veChar[j]);
    Serial.print(",");
  }
  Serial.println();

//float fin=millis();
//Serial.println(fin-inicio);
delay(1000);


}